/* SPDX-License-Identifier: MIT */

/*
 * Athrill's STM32F765Xi SoC layer: Zephyr's stm32f765Xi.dtsi (Apache-2.0,
 * included, not copied) and the Athrill facts the board file does not
 * hold, such as the start-up read rules of the register blocks
 * (athrill-device src/models/register_block.c).
 */
#include <st/f7/stm32f765Xi.dtsi>
#include "../stm32-athrill/stm32f7-athrill.dtsi"
